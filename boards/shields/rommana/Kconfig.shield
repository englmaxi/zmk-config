## boards/shields/rommana/Kconfig.shield
```kconfig
config SHIELD_ROMMANA_DONGLE
    def_bool $(shields_list_contains,rommana_dongle)

config SHIELD_ROMMANA_LEFT
    def_bool $(shields_list_contains,rommana_left)

config SHIELD_ROMMANA_RIGHT
    def_bool $(shields_list_contains,rommana_right)

config SHIELD_ROMMANA_FFC_LEFT
    def_bool $(shields_list_contains,rommana_ffc_left)

config SHIELD_ROMMANA_FFC_RIGHT
    def_bool $(shields_list_contains,rommana_ffc_right)
```

## boards/shields/rommana_ffc/Kconfig.shield
```kconfig
config SHIELD_ROMMANA_FFC_DONGLE
    def_bool $(shields_list_contains,rommana_ffc_dongle)

config SHIELD_ROMMANA_FFC_LEFT
    def_bool $(shields_list_contains,rommana_ffc_left)

config SHIELD_ROMMANA_FFC_RIGHT
    def_bool $(shields_list_contains,rommana_ffc_right)
```

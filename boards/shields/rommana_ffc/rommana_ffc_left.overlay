#include "rommana_ffc.dtsi"

&default_kscan {
    row-gpios
        = <&xiao_d 4 (GPIO_PULL_DOWN | GPIO_ACTIVE_HIGH)>
        , <&xiao_d 5 (GPIO_PULL_DOWN | GPIO_ACTIVE_HIGH)>
        , <&xiao_d 6 (GPIO_PULL_DOWN | GPIO_ACTIVE_HIGH)>
        ;

    col-gpios
        = <&xiao_d 7 GPIO_ACTIVE_HIGH>
        , <&xiao_d 8 GPIO_ACTIVE_HIGH>
        , <&xiao_d 9 GPIO_ACTIVE_HIGH>
        , <&xiao_d 10 GPIO_ACTIVE_HIGH>
        , <&xiao_d 3 GPIO_ACTIVE_HIGH>
        ;
};

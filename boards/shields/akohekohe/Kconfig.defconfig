## boards/shields/akohekohe/Kconfig.defconfig
```kconfig
# Copyright (c) 2022 The ZMK Contributors
# SPDX-License-Identifier: MIT

if SHIELD_AKOHEKOHE

config ZMK_KEYBOARD_NAME
    default "akohekohe"

endif
```

## boards/shields/cosmo/Kconfig.shield
```kconfig
config SHIELD_COSMO_DONGLE
    def_bool $(shields_list_contains,cosmo_dongle)

config SHIELD_COSMO_LEFT
    def_bool $(shields_list_contains,cosmo_left)

config SHIELD_COSMO_RIGHT
    def_bool $(shields_list_contains,cosmo_right)
```

## boards/shields/led_indicator/Kconfig.defconfig
```kconfig
if SHIELD_LED_INDICATOR

config LED
    default y

config LED_INDICATOR_BLINK_MS
    int "Duration of BLE connection status blink in ms"
    default 300

config LED_INDICATOR_INTERVAL_MS
    int "Minimum wait duration between two blinks in ms"
    default 150

config LED_INDICATOR_BATTERY_LEVEL_CRITICAL
    int "Critical battery level percentage"
    default 5

endif
```

## boards/shields/sweep/Kconfig.defconfig
```kconfig
if SHIELD_SWEEP_DONGLE || SHIELD_SWEEP_LEFT || SHIELD_SWEEP_RIGHT

config ZMK_SPLIT
    default y

endif # SHIELD_SWEEP_DONGLE || SHIELD_SWEEP_LEFT || SHIELD_SWEEP_RIGHT


if SHIELD_SWEEP_DONGLE || SHIELD_SWEEP_LEFT

config ZMK_SPLIT_ROLE_CENTRAL
    default y

if ZMK_SPLIT_ROLE_CENTRAL

config ZMK_KEYBOARD_NAME
    default "Sweep"

endif # ZMK_SPLIT_ROLE_CENTRAL

endif # SHIELD_SWEEP_DONGLE || SHIELD_SWEEP_LEFT


if SHIELD_SWEEP_DONGLE

if ZMK_DISPLAY

config I2C
    default y

config SSD1306
    default y

choice ZMK_DISPLAY_WORK_QUEUE
    default ZMK_DISPLAY_WORK_QUEUE_DEDICATED
endchoice

if LVGL

config LV_Z_VDB_SIZE
    default 64

config LV_DPI_DEF
    default 148

config LV_Z_BITS_PER_PIXEL
    default 1

choice LV_COLOR_DEPTH
    default LV_COLOR_DEPTH_1
endchoice

endif # LVGL

endif # ZMK_DISPLAY

endif # SHIELD_SWEEP_DONGLE
```

## boards/shields/sweep/Kconfig.shield
```kconfig
# Copyright (c) 2020 The ZMK Contributors
# SPDX-License-Identifier: MIT

config SHIELD_SWEEP_DONGLE
	def_bool $(shields_list_contains,sweep_dongle)

config SHIELD_SWEEP_LEFT
    def_bool $(shields_list_contains,sweep_left)

config SHIELD_SWEEP_RIGHT
    def_bool $(shields_list_contains,sweep_right)
```

## config/west.yml
```yaml
manifest:
  remotes:
    - name: zmkfirmware
      url-base: https://github.com/zmkfirmware
    - name: caksoylar
      url-base: https://github.com/caksoylar
    - name: urob
      url-base: https://github.com/urob
    - name: englmaxi
      url-base: https://github.com/englmaxi
    - name: ssbb
      url-base: https://github.com/ssbb
    - name: joelspadin
      url-base: https://github.com/joelspadin
  projects:
    - name: zmk
      remote: zmkfirmware
      revision: main
      import: app/west.yml
      
    # modules
    - name: zmk-rgbled-widget
      remote: caksoylar
      revision: main
    - name: zmk-tri-state
      remote: urob
      revision: main
    - name: zmk-dongle-display
      remote: englmaxi
      revision: main
    - name: zmk-antecedent-morph
      remote: ssbb
      revision: main
    - name: zmk-locales
      remote: joelspadin
      revision: main
  self:
    path: config
```
